## drivers/input/fingerprint/et6xx/Kconfig
```kconfig
config FINGERPRINT_ET6XX
	tristate "Finger print card egis et6xx"
	help
	  Say Y here to enable support for retrieving self-test reports.
	  If unsure, say N.
	  To compile this driver as a module, choose M here.
```

## drivers/input/touchscreen/sec_ts/Kconfig
```kconfig
#
# Samsung Electronics TOUCH driver configuration
#

config TOUCHSCREEN_SEC_TS
        tristate "Samsung Electronics Touchscreen"
        depends on I2C
        help
          Say Y here if you want support for SEC touchscreen controllers.
          If unsure, say N.

          To compile this driver as a module, choose M here: the
          module will be called sec_ts.

config TOUCH_DRIVER_NOT_SOD_PROXIMITY
	tristate "touch driver not proximity sensor for SOD mode"
        depends on TOUCHSCREEN_SEC_TS
	default y
	help
	Say Y here if you can use sod proximity.
```
